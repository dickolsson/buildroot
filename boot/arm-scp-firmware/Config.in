## package/skeleton-slashpackage/Config.in
```kconfig
config BR2_PACKAGE_SKELETON_SLASHPACKAGE
	bool
	select BR2_PACKAGE_HAS_SKELETON
	select BR2_PACKAGE_SKELETON_INIT_COMMON
	help
	  The skeleton-slashpackage is an external package providing a
	  configurable rootfs skeleton based on the slashpackage
	  convention and built for skarnet's supervision suite; s6.

config BR2_PACKAGE_PROVIDES_SKELETON
	default "skeleton-slashpackage" if BR2_PACKAGE_SKELETON_SLASHPACKAGE

if BR2_PACKAGE_SKELETON_SLASHPACKAGE

config BR2_PACKAGE_SKELETON_SLASHPACKAGE_CONFIG
	string "skeleton-slashpackage configuration file"
	default "package/skeleton-slashpackage/defconfig"

endif
```

## package/skeleton-slashpackage/defconfig
```kconfig
#
# Target configuration
#
# CONFIG_TARGET_CONTAINER is not set
# end of Target configuration

#
# Init configuration
#
CONFIG_INIT_LOG_CONSOLE=y
CONFIG_INIT_PATH="/command:/usr/bin:/bin"
CONFIG_INIT_DEFAULT_RUNLEVEL="default"
CONFIG_INIT_EARLY_GETTY=y
CONFIG_INIT_EARLY_GETTY_CMD="getty -l /command/login 115200 ttyAMA0 vt100"
# end of Init configuration

#
# Bundle definitions
#
CONFIG_BUNDLE_DEFAULT=y
CONFIG_BUNDLE_LAN=y
CONFIG_BUNDLE_LOCAL=y
CONFIG_BUNDLE_MOUNT_DISKS=y
CONFIG_BUNDLE_MOUNT_VIRTUAL=y
CONFIG_BUNDLE_SSHD=y
# end of Bundle definitions

#
# Service definitions
#
CONFIG_SERVICE_DHCP_ETH0=y
CONFIG_SERVICE_DHCP_ETH0_LOG=y
# CONFIG_SERVICE_DHCPCD_ETH0 is not set
CONFIG_SERVICE_DROPBEAR=y
CONFIG_SERVICE_DROPBEAR_LOG=y
CONFIG_SERVICE_INIT_COLDPLUG=y
CONFIG_SERVICE_INIT_DEV=y
CONFIG_SERVICE_INIT_ETH0=y
CONFIG_SERVICE_INIT_HOSTNAME=y
CONFIG_SERVICE_INIT_HOSTNAME_NAME="skabox"
CONFIG_SERVICE_INIT_LO=y
CONFIG_SERVICE_INIT_SYSCTL=y
CONFIG_SERVICE_INIT_URANDOM=y
CONFIG_SERVICE_KLOGD=y
CONFIG_SERVICE_KLOGD_LOG=y
CONFIG_SERVICE_MDEVD=y
CONFIG_SERVICE_MOUNT_DEVPTS=y
CONFIG_SERVICE_MOUNT_PROC=y
CONFIG_SERVICE_MOUNT_RWFS=y
CONFIG_SERVICE_MOUNT_RWFS_FSTYPE="ext4"
CONFIG_SERVICE_MOUNT_RWFS_DEV="/dev/vda3"
CONFIG_SERVICE_MOUNT_SYS=y
CONFIG_SERVICE_MOUNT_TMP=y
CONFIG_SERVICE_SYSLOGD=y
CONFIG_SERVICE_SYSLOGD_LOG=y
# end of Service definitions
```

## package/skeleton/Config.in
```kconfig
if !BR2_PACKAGE_BUSYBOX && !BR2_PACKAGE_TOYBOX

comment "You may need to enable other packages to get a working system"
comment "You better know what you're doing!"

endif

config BR2_PACKAGE_SKELETON
	bool
	default y

config BR2_PACKAGE_HAS_SKELETON
	bool

config BR2_PACKAGE_PROVIDES_SKELETON
	string
```

## package/socklog/Config.in
```kconfig
config BR2_PACKAGE_SOCKLOG
	bool "socklog"
	select BR2_PACKAGE_SKALIBS
	help
	  socklog is a small and secure replacement for syslogd.

	  http://smarden.org/socklog2/
```

## package/toybox/Config.in
```kconfig
config BR2_PACKAGE_TOYBOX
	bool "Toybox"
	help
	  Toybox combines many common Linux command line utilities together
	  into a single BSD-licensed executable. It's simple, small, fast, and
	  reasonably standards-compliant (POSIX-2008 and LSB 4.1).

	  http://landley.net/toybox

if BR2_PACKAGE_TOYBOX

config BR2_PACKAGE_TOYBOX_CONFIG
	string "Toybox configuration file to use?"
	default "package/toybox/toybox_defconfig"
	help
	  Specifying a custom configuration file will enable a different set
	  of commands to be built.

endif
```
