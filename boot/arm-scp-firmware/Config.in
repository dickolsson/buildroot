## boot/arm-scp-firmware/Config.in
```kconfig
config BR2_TARGET_ARM_SCP_FIRMWARE
	bool "ARM SCP Firmware"
	depends on BR2_aarch64
	help
	  SCP-firmware provides a software reference implementation for the
	  System Control Processor (SCP) and Manageability Control Processor
	  (MCP) components found in several Arm Compute Sub-Systems.

	  https://github.com/ARM-software/SCP-firmware

if BR2_TARGET_ARM_SCP_FIRMWARE

config BR2_TARGET_ARM_SCP_FIRMWARE_PRODUCT
	string "SCP target product"
	help
	  The SCP firmware target product

endif
```

## boot/edk2-platforms/Config.in
```kconfig
config BR2_TARGET_EDK2_PLATFORMS
	bool "edk2-platform"
	help
	  EDK II description files for all supported platforms.

	  https://github.com/tianocore/edk2-platforms
```

## boot/edk2/Config.in
```kconfig
config BR2_TARGET_EDK2
	bool "EDK2"
	help
	  EDK II is a modern, feature-rich, cross-platform firmware
	  development environment for the UEFI and PI specifications.

	  https://github.com/tianocore/tianocore.github.io/wiki/EDK-II

if BR2_TARGET_EDK2

config BR2_TARGET_EDK2_DEBUG
    bool "Debug build"
    help
      Use the debug build type.

choice
    prompt "Package"
    default BR2_TARGET_EDK2_PACKAGE_ARM_VIRT

config BR2_TARGET_EDK2_PACKAGE_ARM_VIRT
	bool "ARM Virt"
	help
	  Package for ARM Virt with support for virtualization platforms like QEMU and Xen.

config BR2_TARGET_EDK2_PACKAGE_ARM_VEXPRESS
	bool "ARM VExpress"
	depends on BR2_TARGET_EDK2_PLATFORMS
	help
	  Package for ARM Versatile Express with support for both ARMv7 and AARCH64 platforms.

config BR2_TARGET_EDK2_PACKAGE_CUSTOM
	bool "Custom package"
	help
	  Use a custom package path defined as BR2_TARGET_EDK2_PACKAGE_CUSTOM_NAME.
	  This option is useful if a package exist in the EDK2 tree, but without a pre-defined choice in Buildroot.

endchoice

if BR2_TARGET_EDK2_PACKAGE_CUSTOM

config BR2_TARGET_EDK2_PACKAGE_CUSTOM_NAME
    string "Custom package path"
    depends on BR2_TARGET_EDK2_PACKAGE_CUSTOM
    help
      Enter the relative path to the package, starting from the EDK2 workspace root.

endif

choice
    prompt "Platform"
    default BR2_TARGET_EDK2_PLATFORM_ARM_VIRT_QEMU

config BR2_TARGET_EDK2_PLATFORM_ARM_VIRT_QEMU
	bool "ARM Virt Qemu (flash)"
	depends on BR2_TARGET_EDK2_PACKAGE_ARM_VIRT
	help
	  Configuration for Qemu targeting the ARM or AArch64 virt machine.
	  This platform will only boot from flash address 0x0. It should therefore be used as the first bootloader.

config BR2_TARGET_EDK2_PLATFORM_ARM_VIRT_QEMU_KERNEL
	bool "ARM Virt Qemu (kernel)"
	depends on BR2_TARGET_EDK2_PACKAGE_ARM_VIRT
	help
	  Configuration for Qemu targeting the ARM or AArch64 virt machine.
	  This platform can boot from either flash address 0x0 or via the Linux boot protocol. It can therefore be loaded
	  by a previous bootloader like ARM Trusted Firmware or OP-TEE.

config BR2_TARGET_EDK2_PLATFORM_ARM_VIRT_XEN
	bool "ARM Virt Xen"
	depends on BR2_TARGET_EDK2_PACKAGE_ARM_VIRT
	help
	  Configuration for Xen targeting ARM or AArch64.

config BR2_TARGET_EDK2_PLATFORM_ARM_VEXPRESS_FVP_AARCH64
	bool "ARM VExpress FVP Aarch64"
	depends on BR2_TARGET_EDK2_PACKAGE_ARM_VEXPRESS
	help
	  Configuration for ARM Versatile Express targeting the Fixed Virtual Platform (FVP) AArch64 platform.

config BR2_TARGET_EDK2_PLATFORM_CUSTOM
	bool "Custom platform"
	help
	  Use a custom platform name defined as BR2_TARGET_EDK2_PLATFORM_CUSTOM_NAME.
	  This option is useful if a platform exist in the EDK2 tree, but without a pre-defined choice in Buildroot.

endchoice

if BR2_TARGET_EDK2_PLATFORM_CUSTOM

config BR2_TARGET_EDK2_PLATFORM_CUSTOM_NAME
    string "Custom platform name"
    depends on BR2_TARGET_EDK2_PLATFORM_CUSTOM
    help
      Enter the platform name, excluding the .dsc file name extension.

config BR2_TARGET_EDK2_FD_CUSTOM_NAME
    string "Custom firmware device name"
    depends on BR2_TARGET_EDK2_PLATFORM_CUSTOM
    help
      Enter the firmware device (FD) image name, excluding the .fd file name extension.

endif

endif
```

## configs/arm_sgi575_defconfig
```kconfig
# Architecture
BR2_aarch64=y

# Toolchain
BR2_TOOLCHAIN_BUILDROOT=y

# System
BR2_TARGET_GENERIC_GETTY_PORT="ttyAMA0"

# Filesystem / image
BR2_TARGET_ROOTFS_EXT2=y
BR2_TARGET_ROOTFS_EXT2_4=y
BR2_TARGET_ROOTFS_EXT2_SIZE="200M"
# BR2_TARGET_ROOTFS_TAR is not set
BR2_ROOTFS_POST_IMAGE_SCRIPT="board/arm/sgi575/assemble-flash-images support/scripts/genimage.sh"
BR2_ROOTFS_POST_SCRIPT_ARGS="-c board/arm/sgi575/genimage.cfg"

# Kernel
BR2_LINUX_KERNEL=y
BR2_LINUX_KERNEL_CUSTOM_VERSION=y
BR2_LINUX_KERNEL_CUSTOM_VERSION_VALUE="5.10.2"
BR2_LINUX_KERNEL_USE_ARCH_DEFAULT_CONFIG=y

# Linux headers same as kernel, a 5.10 series
BR2_PACKAGE_HOST_LINUX_HEADERS_CUSTOM_5_10=y

# UEFI firmware
BR2_TARGET_EDK2=y
BR2_TARGET_EDK2_PLATFORM_ARM_SGI575=y

# ARM Trusted Firmware
BR2_TARGET_ARM_TRUSTED_FIRMWARE=y
BR2_TARGET_ARM_TRUSTED_FIRMWARE_PLATFORM="sgi575"
BR2_TARGET_ARM_TRUSTED_FIRMWARE_EDK2_AS_BL33=y
BR2_TARGET_ARM_TRUSTED_FIRMWARE_FIP=y

# ARM SCP Firmware
BR2_TARGET_ARM_SCP_FIRMWARE=y
BR2_TARGET_ARM_SCP_FIRMWARE_PRODUCT="sgi575"

# Host tools for genimage
BR2_PACKAGE_HOST_GENIMAGE=y
BR2_PACKAGE_HOST_DOSFSTOOLS=y
BR2_PACKAGE_HOST_MTOOLS=y

# host-qemu for testing
BR2_PACKAGE_HOST_QEMU=y
BR2_PACKAGE_HOST_QEMU_SYSTEM_MODE=y
```

## configs/pinebook_pro_defconfig
```kconfig
BR2_aarch64=y
BR2_cortex_a72_a53=y
BR2_ROOTFS_POST_BUILD_SCRIPT="board/pine64/pinebook-pro/post-build.sh"
BR2_ROOTFS_POST_IMAGE_SCRIPT="support/scripts/genimage.sh"
BR2_ROOTFS_POST_SCRIPT_ARGS="-c board/pine64/pinebook-pro/genimage.cfg"
BR2_LINUX_KERNEL=y
BR2_LINUX_KERNEL_CUSTOM_VERSION=y
BR2_LINUX_KERNEL_CUSTOM_VERSION_VALUE="5.10.2"
BR2_LINUX_KERNEL_USE_ARCH_DEFAULT_CONFIG=y
BR2_LINUX_KERNEL_DTS_SUPPORT=y
BR2_LINUX_KERNEL_INTREE_DTS_NAME="rockchip/rk3399-pinebook-pro"
BR2_LINUX_KERNEL_NEEDS_HOST_OPENSSL=y
BR2_TARGET_ROOTFS_EXT2=y
BR2_TARGET_ROOTFS_EXT2_4=y
BR2_TARGET_ARM_TRUSTED_FIRMWARE=y
BR2_TARGET_ARM_TRUSTED_FIRMWARE_PLATFORM="rk3399"
BR2_TARGET_ARM_TRUSTED_FIRMWARE_IMAGES=""
BR2_TARGET_ARM_TRUSTED_FIRMWARE_NEEDS_ARM32_TOOLCHAIN=y
BR2_TARGET_UBOOT=y
BR2_TARGET_UBOOT_BOARD_DEFCONFIG="pinebook-pro-rk3399"
BR2_TARGET_UBOOT_NEEDS_DTC=y
BR2_TARGET_UBOOT_NEEDS_PYTHON3=y
BR2_TARGET_UBOOT_NEEDS_ATF_BL31=y
BR2_TARGET_UBOOT_NEEDS_ATF_BL31_ELF=y
BR2_TARGET_UBOOT_FORMAT_CUSTOM=y
BR2_TARGET_UBOOT_FORMAT_CUSTOM_NAME="u-boot.itb"
BR2_TARGET_UBOOT_SPL=y
BR2_TARGET_UBOOT_SPL_NAME="idbloader.img spl/u-boot-spl-dtb.bin tpl/u-boot-tpl-dtb.bin"
BR2_PACKAGE_HOST_DOSFSTOOLS=y
BR2_PACKAGE_HOST_GENIMAGE=y
BR2_PACKAGE_HOST_MTOOLS=y
BR2_PACKAGE_HOST_UBOOT_TOOLS=y
```

## configs/qemu_aarch64_sbsa_defconfig
```kconfig
# Architecture
BR2_aarch64=y

# Toolchain
BR2_TOOLCHAIN_BUILDROOT=y

# System
BR2_TARGET_GENERIC_GETTY_PORT="ttyAMA0"

# Filesystem / image
BR2_TARGET_ROOTFS_EXT2=y
BR2_TARGET_ROOTFS_EXT2_4=y
BR2_TARGET_ROOTFS_EXT2_SIZE="200M"
# BR2_TARGET_ROOTFS_TAR is not set
BR2_ROOTFS_POST_IMAGE_SCRIPT="board/qemu/aarch64-sbsa/post-image.sh support/scripts/genimage.sh"
BR2_ROOTFS_POST_SCRIPT_ARGS="-c board/qemu/aarch64-sbsa/genimage.cfg"

# Kernel
BR2_LINUX_KERNEL=y
BR2_LINUX_KERNEL_CUSTOM_VERSION=y
BR2_LINUX_KERNEL_CUSTOM_VERSION_VALUE="5.4.53"
BR2_LINUX_KERNEL_USE_ARCH_DEFAULT_CONFIG=y
BR2_LINUX_KERNEL_CONFIG_FRAGMENT_FILES="board/qemu/aarch64-sbsa/linux.fragment"

# Linux headers same as kernel, a 5.4 series
BR2_PACKAGE_HOST_LINUX_HEADERS_CUSTOM_5_4=y

# UEFI firmware
BR2_TARGET_EDK2=y
BR2_TARGET_EDK2_PLATFORM_QEMU_SBSA=y

# ARM Trusted Firmware
BR2_TARGET_ARM_TRUSTED_FIRMWARE=y
BR2_TARGET_ARM_TRUSTED_FIRMWARE_PLATFORM="qemu_sbsa"
BR2_TARGET_ARM_TRUSTED_FIRMWARE_FIP=y

# Host tools for genimage
BR2_PACKAGE_HOST_GENIMAGE=y
BR2_PACKAGE_HOST_DOSFSTOOLS=y
BR2_PACKAGE_HOST_MTOOLS=y

# host-qemu for testing
BR2_PACKAGE_HOST_QEMU=y
BR2_PACKAGE_HOST_QEMU_SYSTEM_MODE=y
```

## configs/qemu_aarch64_sbsa_sbbr_defconfig
```kconfig
# Architecture
BR2_aarch64=y

# Toolchain, required for eudev and grub
BR2_TOOLCHAIN_BUILDROOT_WCHAR=y

# System
BR2_TARGET_GENERIC_GETTY_PORT="ttyAMA0"
BR2_ROOTFS_DEVICE_CREATION_DYNAMIC_EUDEV=y

## Required tools to create bootable media
BR2_PACKAGE_HOST_GENIMAGE=y

# Filesystem / image
BR2_TARGET_ROOTFS_EXT2=y
BR2_TARGET_ROOTFS_EXT2_4=y
BR2_TARGET_ROOTFS_EXT2_SIZE="200M"
# BR2_TARGET_ROOTFS_TAR is not set
BR2_ROOTFS_POST_IMAGE_SCRIPT="board/aarch64-sbsa/post-image.sh support/scripts/genimage.sh"
BR2_ROOTFS_POST_SCRIPT_ARGS="-c board/aarch64-sbsa/genimage-sbsa.cfg"

# Linux headers same as kernel, a 4.18 series
BR2_PACKAGE_HOST_LINUX_HEADERS_CUSTOM_4_18=y

# Kernel
BR2_LINUX_KERNEL=y
BR2_LINUX_KERNEL_CUSTOM_VERSION=y
BR2_LINUX_KERNEL_CUSTOM_VERSION_VALUE="4.18.10"
BR2_LINUX_KERNEL_USE_ARCH_DEFAULT_CONFIG=y
BR2_LINUX_KERNEL_CONFIG_FRAGMENT_FILES="board/aarch64-sbsa/linux.config"
BR2_LINUX_KERNEL_NEEDS_HOST_OPENSSL=y

# UEFI firmware
BR2_TARGET_EDK2=y
BR2_TARGET_EDK2_PLATFORM_QEMU_SBSA=y

# ARM Trusted Firmware
BR2_TARGET_ARM_TRUSTED_FIRMWARE=y
BR2_TARGET_ARM_TRUSTED_FIRMWARE_PLATFORM="qemu_sbsa"
BR2_TARGET_ARM_TRUSTED_FIRMWARE_FIP=y

# Host tools for genimage
BR2_PACKAGE_HOST_DOSFSTOOLS=y
BR2_PACKAGE_HOST_MTOOLS=y
```

## configs/socionext_developerbox_defconfig
```kconfig
BR2_aarch64=y
BR2_PACKAGE_HOST_LINUX_HEADERS_CUSTOM_5_9=y
BR2_ROOTFS_POST_IMAGE_SCRIPT="board/socionext/developerbox/post-image.sh support/scripts/genimage.sh"
BR2_ROOTFS_POST_SCRIPT_ARGS="-c board/socionext/developerbox/genimage.cfg"
BR2_LINUX_KERNEL=y
BR2_LINUX_KERNEL_CUSTOM_VERSION=y
BR2_LINUX_KERNEL_CUSTOM_VERSION_VALUE="5.9.12"
BR2_LINUX_KERNEL_USE_ARCH_DEFAULT_CONFIG=y
BR2_TARGET_ROOTFS_EXT2=y
BR2_TARGET_ROOTFS_EXT2_4=y
BR2_TARGET_ROOTFS_EXT2_SIZE="200M"
# BR2_TARGET_ROOTFS_TAR is not set
BR2_TARGET_ARM_TRUSTED_FIRMWARE=y
BR2_TARGET_ARM_TRUSTED_FIRMWARE_PLATFORM="synquacer"
BR2_TARGET_ARM_TRUSTED_FIRMWARE_ADDITIONAL_TARGETS="bl31 fiptool"
BR2_TARGET_ARM_TRUSTED_FIRMWARE_ADDITIONAL_VARIABLES="PRELOADED_BL33_BASE=0x8200000"
BR2_TARGET_EDK2=y
BR2_TARGET_EDK2_PLATFORM_SOCIONEXT_DEVELOPERBOX=y
BR2_PACKAGE_HOST_DOSFSTOOLS=y
BR2_PACKAGE_HOST_GENIMAGE=y
BR2_PACKAGE_HOST_MTOOLS=y
```

## configs/solidrun_macchiatobin_efi_defconfig
```kconfig
BR2_aarch64=y
BR2_PACKAGE_HOST_LINUX_HEADERS_CUSTOM_5_9=y
BR2_ROOTFS_POST_IMAGE_SCRIPT="board/solidrun/macchiatobin-efi/post-image.sh support/scripts/genimage.sh"
BR2_ROOTFS_POST_SCRIPT_ARGS="-c board/solidrun/macchiatobin-efi/genimage.cfg"
BR2_LINUX_KERNEL=y
BR2_LINUX_KERNEL_CUSTOM_VERSION=y
BR2_LINUX_KERNEL_CUSTOM_VERSION_VALUE="5.9.12"
BR2_LINUX_KERNEL_USE_ARCH_DEFAULT_CONFIG=y
BR2_TARGET_ROOTFS_EXT2=y
BR2_TARGET_ROOTFS_EXT2_4=y
BR2_TARGET_ROOTFS_EXT2_SIZE="200M"
# BR2_TARGET_ROOTFS_TAR is not set
BR2_TARGET_ARM_TRUSTED_FIRMWARE=y
BR2_TARGET_ARM_TRUSTED_FIRMWARE_PLATFORM="a80x0_mcbin"
BR2_TARGET_ARM_TRUSTED_FIRMWARE_EDK2_AS_BL33=y
BR2_TARGET_ARM_TRUSTED_FIRMWARE_ADDITIONAL_TARGETS="mrvl_flash"
BR2_TARGET_ARM_TRUSTED_FIRMWARE_ADDITIONAL_VARIABLES="USE_COHERENT_MEM=0"
BR2_TARGET_BINARIES_MARVELL=y
BR2_TARGET_EDK2=y
BR2_TARGET_EDK2_PLATFORM_SOLIDRUN_ARMADA80X0MCBIN=y
BR2_TARGET_MV_DDR_MARVELL=y
BR2_PACKAGE_HOST_DOSFSTOOLS=y
BR2_PACKAGE_HOST_GENIMAGE=y
BR2_PACKAGE_HOST_MTOOLS=y
```

## package/bmake/Config.in
```kconfig
config BR2_PACKAGE_BMAKE
	bool "bmake"
	select BR2_PACKAGE_MKSH
	help
	  bmake is derived from NetBSD's make(1), its goal is to be a
	  portable version of same, so new features are added via
	  imports of NetBSD's make.

	  http://www.crufty.net/help/sjg/bmake.html
```

## package/bmake/Config.in.host
```kconfig
config BR2_PACKAGE_HOST_BMAKE
	bool "host bmake"
	select BR2_PACKAGE_HOST_MKSH
	help
	  bmake is derived from NetBSD's make(1), its goal is to be a
	  portable version of same, so new features are added via
	  imports of NetBSD's make.

	  http://www.crufty.net/help/sjg/bmake.html
```

## package/mksh/Config.in.host
```kconfig
config BR2_PACKAGE_HOST_MKSH
	bool "host mksh"
	depends on BR2_USE_MMU # fork()
	help
	  This is the host variant of mksh.

	  http://mirbsd.de/mksh
```

## package/s6-linux-init/Config.in.host
```kconfig
config BR2_PACKAGE_HOST_S6_LINUX_INIT
	bool "host s6-linux-init"
	help
	  This package provides the host variant of the s6-linux-init
	  tools, required to build the init program and other necessary
	  scripts.

	  http://skarnet.org/software/s6-linux-init/
```

## package/s6-linux-utils/Config.in
```kconfig
config BR2_PACKAGE_S6_LINUX_UTILS
	bool "s6-linux-utils"
	depends on BR2_USE_MMU # skalibs
	select BR2_PACKAGE_SKALIBS
	help
	  s6-linux-utils is a set of minimalistic Linux-specific
	  system utilities.

	  http://skarnet.org/software/s6-linux-utils/

if BR2_PACKAGE_S6_LINUX_UTILS

config BR2_PACKAGE_S6_LINUX_UTILS_RENAME
	bool "Rename utilities"
	help
	  Rename utikities to their LSB-equivalent name. This might help
	  building a more coherent base system with s6-linux-utils.

endif
```

## package/s6-portable-utils/Config.in
```kconfig
config BR2_PACKAGE_S6_PORTABLE_UTILS
	bool "s6-portable-utils"
	depends on BR2_USE_MMU # skalibs
	select BR2_PACKAGE_SKALIBS
	help
	  s6-portable-utils is a set of tiny general Unix utilities,
	  often performing well-known tasks such as cut and grep, but
	  optimized for simplicity and small size. They were designed
	  for embedded systems and other constrained environments, but
	  they work everywhere.

	  http://skarnet.org/software/s6-portable-utils/

if BR2_PACKAGE_S6_PORTABLE_UTILS

config BR2_PACKAGE_S6_PORTABLE_UTILS_RENAME
	bool "Rename utilities"
	help
	  Rename utilities to their POSIX-equivalent name. This might
	  help building a more coherent base system using s6-portable-utils.

if BR2_PACKAGE_S6_PORTABLE_UTILS_RENAME

config BR2_PACKAGE_S6_PORTABLE_UTILS_RENAME_POSIX_FULL
	bool "Fully POSIX-compliant utilities"
	default y if BR2_PACKAGE_S6_PORTABLE_UTILS_RENAME
	help
	  Select this option if you want to rename the utilities that are
	  fully compliant to their POSIX-equivalent name.

config BR2_PACKAGE_S6_PORTABLE_UTILS_RENAME_POSIX_PART
	bool "Partly POSIX-compliant utilities"
	default y if BR2_PACKAGE_S6_PORTABLE_UTILS_RENAME
	help
	  Select this option if you want to rename the utilities that are
	  partly compliant to their POSIX-equivalent name.

config BR2_PACKAGE_S6_PORTABLE_UTILS_RENAME_POSIX_ALT
	bool "Alternatives to POSIX utilities"
	help
	  Select this option if you want to rename the utilities that are
	  alternative and non-compliant to their POSIX-equivalent name.

	  Only select this option if you really know what you are doing.
	  It will most likely break lots of other utilities and shell
	  scripts. But this option might be useful for building small,
	  secure and more user-friendly base systems with s6-portable-utils.

endif
endif
```

## package/s6-portable-utils/Config.in.host
```kconfig
config BR2_PACKAGE_HOST_S6_PORTABLE_UTILS
	bool "host s6-portable-utils"
	help
	  This package provides the host variant of s6-portable-utils,
	  which is useful when bootstrapping a s6-based system.

	  http://skarnet.org/software/s6-portable-utils/
```

## package/skabox/Config.in
```kconfig
config BR2_PACKAGE_SKABOX
	bool "Skabox"
	depends on BR2_INIT_S6
	select BR2_PACKAGE_S6_LINUX_INIT
	select BR2_PACKAGE_S6_RC
	select BR2_PACKAGE_S6_LINUX_UTILS
	select BR2_PACKAGE_S6_PORTABLE_UTILS
	select BR2_PACKAGE_S6_NETWORKING
	select BR2_PACKAGE_MDEVD
	select BR2_PACKAGE_BEARSSL
	select BR2_PACKAGE_SOCKLOG
	help
	  Skabox is simple and configurable rootfs overlay for s6-based
	  systems with a small set of user-land utilities that together
	  makes up a secure base system.

	  http://senzilla.io/software/skabox

if BR2_PACKAGE_SKABOX

config BR2_PACKAGE_SKABOX_CONFIG
	string "Skabox configuration file"
	default "package/skabox/skabox_defconfig"

endif
```

## package/skeleton-init-s6/Config.in
```kconfig
config BR2_PACKAGE_SKELETON_INIT_S6
	bool
	select BR2_PACKAGE_HAS_SKELETON
	select BR2_PACKAGE_SKELETON_INIT_COMMON
	select BR2_PACKAGE_HOST_S6_RC

config BR2_PACKAGE_PROVIDES_SKELETON
	default "skeleton-init-s6" if BR2_PACKAGE_SKELETON_INIT_S6
```
